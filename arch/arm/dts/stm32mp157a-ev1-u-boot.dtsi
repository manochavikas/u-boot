// SPDX-License-Identifier: GPL-2.0+ OR BSD-3-Clause
/*
 * Copyright : STMicroelectronics 2018
 */

#include "stm32mp157c-ed1-u-boot.dtsi"

/ {
	aliases {
		i2c1 = &i2c2;
		i2c4 = &i2c5;
	};
};

#ifndef CONFIG_TFABOOT
&flash0 {
	u-boot,dm-spl;
};

&qspi {
	u-boot,dm-spl;
};

#endif

